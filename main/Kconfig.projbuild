## main/Kconfig.projbuild
```kconfig
menu "SGP30 Example"

config I2C_SPEED
    int "I2C speed in kHz"
    default 100

config I2C_SDA
    int "I2C SDA port"
    default 21

config I2C_SCL
    int "I2C SCL port"
    default 22

endmenu
```
